## drivers/input/sensor/al3010/Kconfig
```kconfig
#
# I2C gsensor chip drivers configuration
#

config SENSORS_AL3010
	tristate "al3010 sensor support"
	depends on I2C
	select INPUT_POLLDEV
	default m
	help
	  If you say yes here you get support for 
	  sensors AL3010.
```

## drivers/input/sensor/stk8xxx/Kconfig
```kconfig
#
# I2C gsensor chip drivers configuration
#

config SENSORS_STK8XXX
	tristate "stk8xxx acceleration sensor support"
	depends on I2C
	select INPUT_POLLDEV
	default m
	help
	  If you say yes here you get support for 
	  acceleration sensors STK8XXX.
```
